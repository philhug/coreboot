## src/mainboard/hp/proliant_microserver_gen8/Kconfig
```kconfig
if BOARD_HP_PROLIANT_MICROSERVER_GEN8

config BOARD_SPECIFIC_OPTIONS # dummy
	def_bool y
	select BOARD_ROMSIZE_KB_4096 # FIXME: correct this
	select CPU_INTEL_SOCKET_RPGA989
	select HAVE_ACPI_RESUME
	select HAVE_ACPI_TABLES
	select INTEL_INT15
	select NORTHBRIDGE_INTEL_IVYBRIDGE
	select SANDYBRIDGE_IVYBRIDGE_LVDS
	select SERIRQ_CONTINUOUS_MODE
	select SOUTHBRIDGE_INTEL_BD82X6X
	select USE_NATIVE_RAMINIT
	select SUPERIO_SERVERENGINES_PILOT

config HAVE_IFD_BIN
	bool
	default n

config HAVE_ME_BIN
	bool
	default n

config MAINBOARD_DIR
	string
	default hp/proliant_microserver_gen8

config MAINBOARD_PART_NUMBER
	string
	default "ProLiant MicroServer Gen8"

config MAINBOARD_PCI_SUBSYSTEM_DEVICE_ID
	hex
	default 0x0

config MAINBOARD_PCI_SUBSYSTEM_VENDOR_ID
	hex
	default 0x0

config MMCONF_BASE_ADDRESS
	hex
	default 0xf0000000

config DRAM_RESET_GATE_GPIO # FIXME: check this
	int
	default 60

config MAX_CPUS
	int
	default 8

config USBDEBUG_HCD_INDEX # FIXME: check this
	int
	default 2
endif
```

## src/soc/ucb/riscv/Kconfig
```kconfig
config SOC_UCB_RISCV
	select ARCH_RISCV
	select ARCH_BOOTBLOCK_RISCV
	select ARCH_VERSTAGE_RISCV
	select ARCH_ROMSTAGE_RISCV
	select ARCH_RAMSTAGE_RISCV
	select ARCH_USE_ARCH_TIMER
	select BOOTBLOCK_CONSOLE
	select HAVE_MONOTONIC_TIMER
	select GENERIC_UDELAY
	bool
	default n

if SOC_UCB_RISCV

config RISCV_ARCH
	string
	default "rv64imafd"

config RISCV_ABI
	string
	default "lp64d"

config RISCV_CODEMODEL
	string
	default "medany"

endif
```
